## conf/distro/distro-custom.conf
```bitbake
require conf/distro/poky.conf

DISTRO = "distro-custom"
DISTRO_NAME = "Distro-custom (Fernando Palarmini based on poky yocto)"
DISTRO_VERSION = "1.0.0"
DISTRO_CODENAME = "Distro-Fer"

INHERIT += "extrausers"
EXTRA_USERS_PARAMS = "useradd -P fernando fernando; \
    usermod -P fernando root;"


# qt com rasp
DISTRO_FEATURES_remove = "x11 wayland"

# to enable systemd instead of sysV
DISTRO_FEATURES_append = " systemd"
VIRTUAL-RUNTIME_init_manager = "systemd"
DISTRO_FEATURES_BACKFILL_CONSIDERED = "sysvinit"
VIRTUAL-RUNTIME_initscripts = ""
```
